## conf/layer.conf
```bitbake
# We have a conf and classes directory, add to BBPATH
BBPATH .= ":${LAYERDIR}"

# We have a packages directory, add to BBFILES
BBFILES += "${LAYERDIR}/recipes-*/*/*.bb \
            ${LAYERDIR}/recipes-*/*/*.bbappend"

BBFILE_COLLECTIONS += "ar802"
BBFILE_PATTERN_ar802 := "^${LAYERDIR}/"
BBFILE_PRIORITY_ar802 = "6"
```

## conf/machine/ar802.conf
```bitbake
#@TYPE: Machine
#@NAME: Zealz GK802 Mini PC TV Stick
#@SOC: i.MX6Q
#@DESCRIPTION: Machine configuration for Zealz GK802 Mini PC TV Stick

include conf/machine/include/imx-base.inc
include conf/machine/include/tune-cortexa9.inc

SOC_FAMILY = "mx6:mx6q"

PREFERRED_PROVIDER_u-boot = "u-boot-ar802"
PREFERRED_PROVIDER_virtual/kernel = "linux-imx-ar802"

UBOOT_MACHINE = "gk802_config"

SERIAL_CONSOLE = "115200 ttymxc3"

MACHINE_EXTRA_RRECOMMENDS += "linux-firmware-rtl8192cu"

MACHINE_FEATURES += " pci wifi bluetooth"

PREFERRED_PROVIDER_jpeg = "libjpeg-turbo"
PREFERRED_PROVIDER_jpeg-native = "libjpeg-turbo-native"
```
